/********************************End of File************************************//********************************Copyright (c)**********************************\
**
**                   (c) Copyright 2019, temp_duan, China, DY.
**                           All Rights Reserved
**
**                           By(德阳科派科技有限公司)
**                             http://www.kpiot.top
**
**----------------------------------文件信息------------------------------------
** 文件名称: main.c
** 创建人员: temp_duan
** 创建日期: 2019-07-09
** 文档描述:
**
**----------------------------------版本信息------------------------------------
** 版本代号: V0.1
** 版本说明: 初始版本
**
**------------------------------------------------------------------------------
\********************************End of Head************************************/

/********************************End of File************************************/
#include "stm32f10x.h"
#include "led.h"
#include "jdq.h"
#include "key.h"
#include "sys.h"
#include "timer.h"
#include "delay.h"
#include "usart.h"
#include "usart3.h"
#include "iwdg.h"
#include "exti.h"
#include "beep.h"
#include "door.h"
#include "DHT11.h"
#include "adcx.h"
#include "ds18b20.h"

#include "gizwits_product.h"

dataPoint_t currentDataPoint;
extern u8 wifi_flag;
u8 key_flag;
u8 temp,hum;
/*******************************************************************************
** 函数名称: Gizwits_Init
** 功能描述: 
** 参数说明: None
** 返回说明: None
** 创建人员: temp_duan
** 创建日期: 2019-07-24
**------------------------------------------------------------------------------
** 修改人员:
** 修改日期:
** 修改描述:
**------------------------------------------------------------------------------
********************************************************************************/
void Gizwits_Init(void)
{
    TIM4_Int_Init(9, 7199);
    usart3_init(9600); // wifi初始化 波特率必须为9600
    memset((uint8_t *)&currentDataPoint, 0, sizeof(dataPoint_t));
    gizwitsInit();
}


/*******************************************************************************
** 函数名称: userHandle
** 功能描述: 
** 参数说明: None
** 返回说明: None
** 创建人员: temp_duan
** 创建日期: 2019-08-01
**------------------------------------------------------------------------------
** 修改人员:
** 修改日期:
** 修改描述:
**------------------------------------------------------------------------------
********************************************************************************/
void userHandle(void)
{
	if(wifi_flag == 1)
	{
		DHT11_Read_Data(&temp,&hum);
		currentDataPoint.valuetemp = temp;
		currentDataPoint.valuehum  = hum;
	}
    
}

/*******************************************************************************
** 函数名称: Hardware_Init
** 功能描述:
** 参数说明: None
** 返回说明: None
** 创建人员: temp_duan
** 创建日期: 2019-07-09
**------------------------------------------------------------------------------
** 修改人员:
** 修改日期:
** 修改描述:
**------------------------------------------------------------------------------
********************************************************************************/
void Hardware_Init(void)
{
    NVIC_PriorityGroupConfig(NVIC_PriorityGroup_2);
    Delay_Init();
    usart_init(115200);
    LED_Init();
		KEY_Init();
		Relay_init();
		beep_init();
		door_init();
		DHT11_Init();
		Gizwits_Init();
		printf("\r\n 初始化成功\r\n");
}

/*******************************************************************************
** 函数名称: key_scanf
** 功能描述: 
** 参数说明: None
** 返回说明: None
** 创建人员: temp_duan
** 创建日期: 2019-07-30
**------------------------------------------------------------------------------
** 修改人员:
** 修改日期:
** 修改描述:
**------------------------------------------------------------------------------
********************************************************************************/
void key_scanf(void)
{
	if(KEY1 == RESET)
	{
		DelayMs(10);
		if(KEY1 == RESET)
		{
			gizwitsSetMode(WIFI_AIRLINK_MODE);
			printf("\r\n AirLink mode \r\n");
		}
		while(!KEY1);
	}
}
/*******************************************************************************
** 函数名称: main
** 功能描述:
** 参数说明: None
** 返回说明: None
** 创建人员: temp_duan
** 创建日期: 2019-07-09
**------------------------------------------------------------------------------
** 修改人员:
** 修改日期:
** 修改描述:
**------------------------------------------------------------------------------
********************************************************************************/
int main(void)
{

    Hardware_Init();

    while(1)
    {
			key_scanf();
			userHandle();
			gizwitsHandle((dataPoint_t *)&currentDataPoint); //协议处理
       
    }
}

